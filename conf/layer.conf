## conf/layer.conf
```bitbake
# We have a conf and classes directory, add to BBPATH
BBPATH .= ":${LAYERDIR}"

# We have recipes-* directories, add to BBFILES
BBFILES += "${LAYERDIR}/recipes-*/*/*.bb \\
            ${LAYERDIR}/recipes-*/*/*.bbappend"

BBFILE_COLLECTIONS += "irobot-common"
BBFILE_PATTERN_irobot-common = "^${LAYERDIR}/"
BBFILE_PRIORITY_irobot-common = "6"
LAYERSERIES_COMPAT_irobot-common = "thud warrior"

# IMHO, this is an abuse of layer.conf, but I cannot find a better
# way to do this.  This layer contains the cleantrack recipe, which
# builds cleantrack, which now requires "git-lfs" in order to clone
# the repository.  By default, Yocto does not include git-lfs,
# so we must use the version from the host environment.  This is the
# purpose of the HOSTTOOLS variable.  IMHO, the right place to set
# this variable would be in the cleantrack recipe, but it needs to be
# a global configuration file (like local.conf), but this meets a
# need for one, very specific recipe.  So I put it here.
#
# An alternative way to do this would be to have the
# meta-mediatek-mt7688/conf/machine/sundial.conf
# file include a conf/machine/sundial-irobot-common.conf
# file and to have that file define HOSTTOOLS, which seems
# equally ugly.
HOSTTOOLS += "git-lfs"
```

## conf/machine/include/useradd-apps.inc
```bitbake
# This file is intended to be included in recipes that needs to add apps
# user to provide ownership/permission of some files to apps user/group
inherit useradd
USERADD_PACKAGES = "${PN}"
USERADD_PARAM_${PN} = "--uid 1000 --user-group --password '' apps"
```
